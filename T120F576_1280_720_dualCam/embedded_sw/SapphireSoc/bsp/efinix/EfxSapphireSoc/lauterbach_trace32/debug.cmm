; -------------------------------------------------------------------------------
; SapphireSoC Debug
; -------------------------------------------------------------------------------
; initialize and start the debugger
RESet
SYStem.RESet
SYStem.CPU RV32
SYStem.Option.ResetMode NDMRST
SYStem.Option.IMASKASM on
SYStem.Up

; --------------------------------------------------------------------------------
; load demo program 
Data.LOAD.Elf ./build/demo.elf /Verify

; --------------------------------------------------------------------------------
; start program execution
Go.direct main
WAIT !STATE.RUN()

; --------------------------------------------------------------------------------
; open some windows
;WinCLEAR
Mode.Hll
WinPOS 0. 0. 116. 26.
List.auto
WinPOS 120. 0. 100. 8.
Frame.view
WinPOS 120. 14.


ENDDO
